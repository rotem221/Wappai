#include "face.h"
#include <algorithm>
#if defined(ARDUINO_ARCH_ESP32)
#include <esp_heap_caps.h>
#endif
#include <string.h>
#include <stddef.h>
#include "sdf.h"
#include "emotions.gen.h"   // generated by tools/gen_face.py from character/creature.json

static const int NF = sizeof(FaceP) / sizeof(float);
static const float DEG = 0.017453293f;

// ---------------------------------------------------------------- pixel helpers
struct Col { float r, g, b; };
static inline Col hexc(uint32_t h) { return {((h >> 16) & 255) / 255.f, ((h >> 8) & 255) / 255.f, (h & 255) / 255.f}; }

struct Px { uint16_t v; int r, g, b; };   // packed colour (565) + 8-bit channels
static inline Px mkpx(Col c) {
    int r = (int)(c.r * 255 + .5f), g = (int)(c.g * 255 + .5f), b = (int)(c.b * 255 + .5f);
    uint16_t v = (uint16_t)(((r >> 3) << 11) | ((g >> 2) << 5) | (b >> 3));
    return {v, r, g, b};
}
static inline void blendPx(Canvas &c, int x, int y, const Px &col, float a, uint16_t solid) {
    uint16_t *p = c.px + y * c.w + x;
    if (a >= 0.996f) { *p = solid; return; }
    int ai = (int)(a * 256.f);
    if (ai <= 0) return;
    uint16_t v = *p;
    if (c.swapped) v = (uint16_t)((v >> 8) | (v << 8));
    int r = ((v >> 11) & 31) << 3, g = ((v >> 5) & 63) << 2, b = (v & 31) << 3;
    r += ((col.r - r) * ai) >> 8; g += ((col.g - g) * ai) >> 8; b += ((col.b - b) * ai) >> 8;
    uint16_t o = (uint16_t)(((r >> 3) << 11) | ((g >> 2) << 5) | (b >> 3));
    if (c.swapped) o = (uint16_t)((o >> 8) | (o << 8));
    *p = o;
}

// Screen <-> face transform for the current frame
struct Xf {
    float cx, cy, s, c, sn;   // centre, scale, cos/sin of rotation
    V2 toFace(float x, float y) const {
        float dx = (x - cx) / s, dy = (y - cy) / s;
        return {dx * c + dy * sn, -dx * sn + dy * c};
    }
    void toScreen(float fx, float fy, float &x, float &y) const {
        x = cx + (fx * c - fy * sn) * s;
        y = cy + (fx * sn + fy * c) * s;
    }
};

// Paint one shape: sdf(q) in face units, glow halo in screen pixels
static bool g_exactPaint = false;   // set for shapes whose SDF is far from a true distance (the open mouth)
template <class F>
static void paint(Canvas &cv, const Xf &xf, float bx0, float by0, float bx1, float by1, Col colf, float alpha, float glow,
                  Face *owner, F sdf, void (*track)(Face *, int, int, int, int)) {
    if (alpha <= 0.01f) return;
    const float G = 13.f;   // glow radius (px)
    const bool small = (bx1 - bx0) * xf.s < 56.f && (by1 - by0) * xf.s < 56.f;   // before the glow padding
    float pad = (glow > 0 ? G : 1.5f) / xf.s + 2;
    bx0 -= pad; by0 -= pad; bx1 += pad; by1 += pad;
    float xs[4], ys[4];
    xf.toScreen(bx0, by0, xs[0], ys[0]); xf.toScreen(bx1, by0, xs[1], ys[1]);
    xf.toScreen(bx0, by1, xs[2], ys[2]); xf.toScreen(bx1, by1, xs[3], ys[3]);
    float mnx = xs[0], mxx = xs[0], mny = ys[0], mxy = ys[0];
    for (int i = 1; i < 4; i++) {
        if (xs[i] < mnx) mnx = xs[i]; if (xs[i] > mxx) mxx = xs[i];
        if (ys[i] < mny) mny = ys[i]; if (ys[i] > mxy) mxy = ys[i];
    }
    int x0 = (int)mnx, y0 = (int)mny, x1 = (int)mxx + 2, y1 = (int)mxy + 2;
    if (x0 < 0) x0 = 0; if (y0 < 0) y0 = 0; if (x1 > cv.w) x1 = cv.w; if (y1 > cv.h) y1 = cv.h;
    if (x1 <= x0 || y1 <= y0) return;
    track(owner, x0, y0, x1, y1);
    const float s = xf.s;
    const Px col = mkpx(colf);
    const uint16_t solid = cv.swapped ? (uint16_t)((col.v >> 8) | (col.v << 8)) : col.v;
    const float outer = glow > 0 ? G : 0.5f;
    // 8x8 tiles. The distance is sampled at the tile corners (a shared grid) and interpolated inside the tile:
    // the glow and the far inside/outside only need that. Exact per-pixel evaluation happens only within ~3 px of
    // the outline, where it decides the anti-aliased edge. ~5x fewer SDF calls than evaluating every edge pixel.
    const int T = 8;
    const int nx = (x1 - x0 + T - 1) / T;
    static float rowA[80], rowB[80];
    float *top = rowA, *bot = rowB;
    const float invScale=1.f/s;
    auto sample = [&](float px, float py) {
        float dx=(px-xf.cx)*invScale,dy=(py-xf.cy)*invScale;
        return sdf(v2(dx*xf.c+dy*xf.sn,-dx*xf.sn+dy*xf.c))*s;
    };
    for (int i = 0; i <= nx; i++) top[i] = sample((float)(x0 + i * T < x1 ? x0 + i * T : x1), (float)y0);
    for (int ty = y0; ty < y1; ty += T) {
        int ty1 = ty + T < y1 ? ty + T : y1;
        for (int i = 0; i <= nx; i++) bot[i] = sample((float)(x0 + i * T < x1 ? x0 + i * T : x1), (float)ty1);
        for (int i = 0; i < nx; i++) {
            int tx = x0 + i * T, tx1 = tx + T < x1 ? tx + T : x1;
            float d00 = top[i], d10 = top[i + 1], d01 = bot[i], d11 = bot[i + 1];
            float dmin = fminf(fminf(d00, d10), fminf(d01, d11)), dmax = fmaxf(fmaxf(d00, d10), fmaxf(d01, d11));
            // SDFs are only approximately distance-preserving; small shapes (sparkles, dots, thin spikes) are drawn
            // exactly, interpolation would round their points off
            const float slack = small ? 1e9f : (g_exactPaint ? 6.f : 4.f);   // tile skip / solid margin
            const float exactBand = (small || g_exactPaint) ? 1e9f : 4.f;      // exact SDF within this of the edge
            if (dmin > outer + slack) continue;                // far outside
            if (dmax < -1.f - slack) {                         // deep inside
                for (int y = ty; y < ty1; y++)
                    for (int x = tx; x < tx1; x++) blendPx(cv, x, y, col, alpha, solid);
                continue;
            }
            const float iw = 1.f / (tx1 - tx), ih = 1.f / (ty1 - ty);
            for (int y = ty; y < ty1; y++) {
                float v = (y + .5f - ty) * ih;
                float dl = d00 + (d01 - d00) * v, dr = d10 + (d11 - d10) * v;
                for (int x = tx; x < tx1; x++) {
                    float u = (x + .5f - tx) * iw;
                    float d = dl + (dr - dl) * u;
                    if (d > -exactBand && d < exactBand) d = sample(x + .5f,y + .5f);   // the edge: exact
                    float a = d <= 0.5f ? cover(d) : 0.f;
                    if (glow > 0 && d > -0.5f && d < G) {
                        float k = 1.f - d / G;
                        float ga = glow * 0.38f * k * k;
                        if (ga > a) a = ga;
                    }
                    if (a > 0.004f) blendPx(cv, x, y, col, a * alpha, solid);
                }
            }
        }
        float *t = top; top = bot; bot = t;
    }
}

// ---------------------------------------------------------------- public helpers
int Face::count() { return N_EMOTIONS; }
const char *Face::name(int i) { return (i >= 0 && i < N_EMOTIONS) ? EMOTIONS[i].name : ""; }
const char *Face::emotionName() const { return name(emo_); }

float Face::rnd() {
    rng_ ^= rng_ << 13; rng_ ^= rng_ >> 17; rng_ ^= rng_ << 5;
    return (rng_ & 0xFFFFFF) / 16777216.f;
}

void Face::begin(uint32_t seed) {
    rng_ = seed ? seed : 1;
    cur_ = tgt_ = EMOTIONS[0].p;
    memset(&vel_, 0, sizeof(vel_));
    emo_ = 0;
    for (int i = 0; i < 2; i++) eyeShape_[i] = eyeShapeTgt_[i] = (uint8_t)cur_.eye[i].shape;
    mouthShape_ = mouthShapeTgt_ = (uint8_t)cur_.mshape;
    anim_ = (uint8_t)cur_.anim;
    fxTgt_ = (uint16_t)cur_.fx;
}

void Face::setEmotionIndex(int i) {
    if (i < 0 || i >= N_EMOTIONS) return;
    custom_ = false;
    emo_ = i;
    tgt_ = EMOTIONS[i].p;
    for (int e = 0; e < 2; e++) {
        uint8_t s = (uint8_t)tgt_.eye[e].shape;
        if (s != eyeShapeTgt_[e]) { eyeShapeTgt_[e] = s; if (eyeSwap_[e] >= 1) eyeSwap_[e] = 0; }
    }
    uint8_t ms = (uint8_t)tgt_.mshape;
    if (ms != mouthShapeTgt_) { mouthShapeTgt_ = ms; if (mouthSwap_ >= 1) mouthSwap_ = 0; }
    anim_ = (uint8_t)tgt_.anim;
    fxTgt_ = (uint16_t)tgt_.fx;
}

bool Face::setEmotion(const char *n) {
    for (int i = 0; i < N_EMOTIONS; i++)
        if (!strcmp(EMOTIONS[i].name, n)) { setEmotionIndex(i); return true; }
    return false;
}

void Face::setExpression(const PipPose &p) {
    setEmotionIndex(0);pixelPose_=p;custom_=true;poseSpeed_=clampf(p.speed,.3f,2);posePulse_=clampf(p.mouthPulse,0,1);poseWave_=clampf(p.armWave,0,1);
    for(int e=0;e<2;e++) {tgt_.eye[e].h=98*clampf(p.eyeOpen,.04f,1.4f)*(1.f-fmaxf(0,clampf(p.wink,-1,1)*(e==0?-1:1)));tgt_.brow[e].a=fabsf(p.brow);tgt_.brow[e].ang=clampf(p.brow,-1,1)*20;tgt_.eye[e].hl=0;if(p.eyeOpen<.35f && p.smile>.5f){tgt_.eye[e].shape=EYE_ARC_UP;eyeShapeTgt_[e]=EYE_ARC_UP;eyeSwap_[e]=0;}}
    tgt_.mcurve=15*clampf(p.smile,-1,1);tgt_.mopen=40*clampf(p.mouthOpen,0,1);
    tgt_.rot=clampf(p.tilt,-.35f,.35f)/DEG;
    armLT_=clampf(p.leftArm,0,2.4f);armRT_=clampf(p.rightArm,0,2.4f);
    tgt_.anim=A_BOUNCE;anim_=A_BOUNCE;tgt_.animAmp=clampf(p.bounce,0,.2f)*10;
    lookAt(p.gazeX,-p.gazeY,10000);
}

enum { G_NONE, G_NOD, G_SHAKE, G_JUMP, G_POP, G_TILT_L, G_TILT_R, G_WIGGLE };
void Face::gesture(const char *g) {
    if (!strcmp(g, "blink")) { blinkT_ = 0.0001f; return; }
    if (!strcmp(g, "look_left")) { lookAt(-0.9f, 0, 1200); return; }
    if (!strcmp(g, "look_right")) { lookAt(0.9f, 0, 1200); return; }
    struct { const char *n; uint8_t id; float d; } tab[] = {
        {"nod", G_NOD, 0.9f}, {"shake", G_SHAKE, 0.8f}, {"jump", G_JUMP, 0.55f}, {"bounce", G_JUMP, 0.55f},
        {"pop", G_POP, 0.35f}, {"tilt_left", G_TILT_L, 1.4f}, {"tilt_right", G_TILT_R, 1.4f}, {"wiggle", G_WIGGLE, 0.9f}};
    for (auto &e : tab)
        if (!strcmp(g, e.n)) { gest_ = e.id; gestT_ = 0; gestDur_ = e.d; return; }
}

void Face::lookAt(float x, float y, uint32_t holdMs) {
    lookTX_ = clampf(x, -1, 1);
    lookTY_ = clampf(y, -1, 1);
    lookHold_ = holdMs / 1000.f;
}

// ---------------------------------------------------------------- simulation
static inline void spring(float &x, float &v, float target, float w, float dt, float zeta = 1.f) {
    float a = w * w * (target - x) - 2.f * zeta * w * v;
    v += a * dt;
    x += v * dt;
}

void Face::update(float dt) {
    // Springs are integrated explicitly: large steps (slow frames, waking from screen-off) make them diverge
    // and the face flies off screen. Sub-step at <= 1/120 s and guard against NaN.
    if (!(dt > 0)) dt = 0.016f;
    if (dt > 0.25f) dt = 0.25f;
    while (dt > 1.f / 120.f) { step(1.f / 120.f); dt -= 1.f / 120.f; }
    if (dt > 0) step(dt);
    float *c = (float *)&cur_, *v = (float *)&vel_;
    bool bad = !isfinite(lookX_) || !isfinite(lookY_) || !isfinite(tiltS_);
    for (int i = 0; i < NF && !bad; i++) bad = !isfinite(c[i]) || !isfinite(v[i]);
    if (bad) {   // never leave the screen blank
        cur_ = tgt_;
        memset(&vel_, 0, sizeof(vel_));
        lookX_ = lookY_ = lookVX_ = lookVY_ = 0;
        tiltS_ = talkS_ = 0;
    }
}

void Face::step(float dt) {
    float ease=1.f-expf(-dt*12.f);armL_+=(armLT_-armL_)*ease;armR_+=(armRT_-armR_)*ease;
    t_ += dt;
    float *c = (float *)&cur_, *v = (float *)&vel_;
    const float *g = (const float *)&tgt_;
    // Under-damped (zeta 0.62): a change of expression overshoots a touch and settles - alive, not robotic.
    // Colour, glow and discrete selectors stay critically damped (no colour flicker).
    static const int C0 = offsetof(FaceP, cr) / sizeof(float), C1 = offsetof(FaceP, anim) / sizeof(float);
    for (int i = 0; i < NF; i++) spring(c[i], v[i], g[i], 13.f, dt, (i >= C0 && i < C1) ? 1.f : 0.62f);
    // discrete parts follow their own swaps
    for (int e = 0; e < 2; e++) {
        if (eyeSwap_[e] < 1) {
            float before = eyeSwap_[e];
            eyeSwap_[e] += dt / 0.24f;
            if (before < 0.5f && eyeSwap_[e] >= 0.5f) eyeShape_[e] = eyeShapeTgt_[e];
            if (eyeSwap_[e] >= 1) { eyeSwap_[e] = 1; eyeShape_[e] = eyeShapeTgt_[e]; }
        }
    }
    if (mouthSwap_ < 1) {
        float before = mouthSwap_;
        mouthSwap_ += dt / 0.22f;
        if (before < 0.5f && mouthSwap_ >= 0.5f) mouthShape_ = mouthShapeTgt_;
        if (mouthSwap_ >= 1) { mouthSwap_ = 1; mouthShape_ = mouthShapeTgt_; }
    }
    for (int i = 0; i < FX_COUNT; i++) {
        float tg = (fxTgt_ >> i) & 1 ? 1.f : 0.f;
        fxA_[i] += clampf(tg - fxA_[i], -dt * 3.f, dt * 3.f);
    }
    // blink
    if (blinkT_ > 0) {
        blinkT_ += dt;
        const float D = 0.16f;
        float k = blinkT_ / D;
        float b = k < 0.42f ? k / 0.42f : (k < 1 ? 1 - (k - 0.42f) / 0.58f : 0);
        blink_ = b * b * (3 - 2 * b);    // smoothstep: soft lids instead of a linear snap
        if (k >= 1) {
            blinkT_ = 0; blink_ = 0;
            if (doubleBlink_) { doubleBlink_ = false; blinkT_ = 0.0001f; nextBlink_ = t_ + 0.05f; }
        }
    } else if (t_ > nextBlink_) {
        blinkT_ = 0.0001f;
        doubleBlink_ = rnd() < 0.18f;
        nextBlink_ = t_ + 2.2f + rnd() * 4.f;
    }
    // idle life: every 7-16 s a small, friendly action
    if (idle_ && !gest_ && t_ > nextIdle_) {
        float r = rnd();
        if (r < 0.28f) { lookTX_ = rnd() < 0.5f ? -0.85f : 0.85f; lookTY_ = -0.15f; lookHold_ = 1.1f; }   // glance around
        else if (r < 0.44f) { gest_ = G_JUMP; gestT_ = 0; gestDur_ = 0.5f; }                                 // little hop
        else if (r < 0.62f) { gest_ = rnd() < 0.5f ? G_TILT_L : G_TILT_R; gestT_ = 0; gestDur_ = 1.6f; }       // curious tilt
        else if (r < 0.76f) { gest_ = G_WIGGLE; gestT_ = 0; gestDur_ = 0.9f; }                                // happy wiggle
        else { slowBlink_ = 0.0001f; }                                                                         // content slow blink
        nextIdle_ = t_ + 7.f + rnd() * 9.f;
    }
    if (slowBlink_ > 0) {                 // eyes close softly, stay a moment, reopen (cat-like "I'm comfortable")
        slowBlink_ += dt;
        float k = slowBlink_ / 1.1f;
        blink_ = fmaxf(blink_, k < 0.35f ? k / 0.35f * 0.85f : (k < 0.65f ? 0.85f : (k < 1 ? 0.85f * (1 - (k - 0.65f) / 0.35f) : 0)));
        if (k >= 1) slowBlink_ = 0;
    }
    // gaze: hold explicit look, otherwise small random saccades (calmer while listening)
    if (lookHold_ > 0) lookHold_ -= dt;
    else if (t_ > nextSaccade_) {
        float amp = attention_ ? 0.18f : 0.55f;
        lookTX_ = (rnd() * 2 - 1) * amp;
        lookTY_ = (rnd() * 2 - 1) * amp * 0.6f;
        if (rnd() < 0.35f) { lookTX_ = 0; lookTY_ = 0; }
        nextSaccade_ = t_ + (attention_ ? 2.5f : 1.2f) + rnd() * 2.8f;
    }
    spring(lookX_, lookVX_, lookTX_, 22.f, dt);   // fast like real saccades
    spring(lookY_, lookVY_, lookTY_, 22.f, dt);
    talkS_ += (talk_ - talkS_) * clampf(dt * 22.f, 0, 1);
    tiltS_ += (clampf(tilt_, -14, 14) - tiltS_) * clampf(dt * 6.f, 0, 1);
    attS_ += ((attention_ ? 1.f : 0.f) - attS_) * clampf(dt * 6.f, 0, 1);
    centerDyS_ += (centerDy_ - centerDyS_) * clampf(dt * 8.f, 0, 1);
    zoomS_ += (zoom_ - zoomS_) * clampf(dt * 8.f, 0, 1);
    if (gest_) { gestT_ += dt; if (gestT_ >= gestDur_) gest_ = G_NONE; }
}

// ---------------------------------------------------------------- render
static Face *g_track = nullptr;

void Face::addRect(int x0, int y0, int x1, int y1) {
    if (nCur_ < 32) cur_rects_[nCur_++] = {x0, y0, x1, y1};
    else {   // merge into last
        Rect &r = cur_rects_[31];
        if (x0 < r.x0) r.x0 = x0; if (y0 < r.y0) r.y0 = y0; if (x1 > r.x1) r.x1 = x1; if (y1 > r.y1) r.y1 = y1;
    }
}

static void trackCb(Face *f, int x0, int y0, int x1, int y1);
#include "pixel_art.gen.h"
#include "pixel_motions.gen.h"

// A quiet, fixed pixel field behind the character. No timers, sparkle loops,
// allocations or full-screen compositing; the existing dirty region restores it.
static Rect drawPixelHalo(Canvas &cv,int cx,int cy,float pixelScale,float centerY) {
    const float size=std::min(pixelScale,std::min(cv.w/320.f,cv.h/300.f));
    Rect bounds{cv.w,cv.h,0,0};
    for(int gy=-13;gy<=13;gy++)for(int gx=-15;gx<=15;gx++) {
        float radial=(gx*gx)/(15.f*15.f)+(gy*gy)/(13.f*13.f);
        if(radial>=1.f)continue;
        uint32_t seed=(uint32_t)(gx+16)*73856093u ^ (uint32_t)(gy+14)*19349663u;
        if(seed%7==0 || (radial>.75f && seed%3==0))continue;
        float fade=(1.f-radial)*(0.55f+(seed%11)*.045f);
        int r=(int)(4+fade*8),g=(int)(8+fade*52),b=(int)(14+fade*90);
        if(seed%23==0){g+=int(fade*16);b+=int(fade*18);}
        uint16_t color=(r>>3)<<11|(g>>2)<<5|(b>>3);
        if(cv.swapped)color=(color>>8)|(color<<8);
        int side=std::max(1,(int)((seed%9==0?4:3)*size));
        int left=(int)(cx+gx*9*size)-side/2,top=(int)(cy+centerY+gy*9*size)-side/2;
        int x0=std::max(0,left),y0=std::max(0,top),x1=std::min(cv.w,left+side),y1=std::min(cv.h,top+side);
        if(x0>=x1 || y0>=y1)continue;
        for(int y=y0;y<y1;y++)for(int x=x0;x<x1;x++)cv.px[y*cv.w+x]=color;
        bounds.x0=std::min(bounds.x0,x0);bounds.y0=std::min(bounds.y0,y0);
        bounds.x1=std::max(bounds.x1,x1);bounds.y1=std::max(bounds.y1,y1);
    }
    return bounds;
}

#if defined(__GNUC__) && !defined(__clang__)
__attribute__((optimize("O3")))
#endif
Rect Face::render(Canvas &cv, int cx, int cy, float pixelScale) {
    // 1) erase what we drew last frame
    Rect dirty = {cv.w, cv.h, 0, 0};
    for (int i = 0; i < nPrev_; i++) {
        Rect r = prev_[i];
        for (int y = r.y0; y < r.y1; y++) memset(cv.px + y * cv.w + r.x0, 0, (r.x1 - r.x0) * 2);
        if (r.x0 < dirty.x0) dirty.x0 = r.x0; if (r.y0 < dirty.y0) dirty.y0 = r.y0;
        if (r.x1 > dirty.x1) dirty.x1 = r.x1; if (r.y1 > dirty.y1) dirty.y1 = r.y1;
    }
    nCur_ = 0;
    g_track = this;
    Rect halo=drawPixelHalo(cv,cx,cy,pixelScale,centerDyS_*pixelScale);

    const bool dizzy = !strcmp(emotionName(),"dizzy") || (custom_ && !strcmp(pixelPose_.motion,"dizzy"));
    const FaceP &P = cur_;
    const float t = reduced_ ? 0.f : t_*(custom_ ? poseSpeed_:1.f);
    // 2) body motion -> transform
    float ox = 0, oy = P.dy + centerDyS_, sc = P.scale * zoomS_ * (1.f + 0.035f * attS_), rotd = P.rot - tiltS_ * 0.6f;
    float am = reduced_ ? 0 : P.animAmp;
    switch (anim_) {
        case A_SWAY: rotd += 4.f * am * sinf(t * 2.1f); ox += 5.f * am * sinf(t * 2.1f); break;
        case A_BOUNCE: oy -= fabsf(sinf(t * 6.5f)) * 11.f * am; break;
        case A_TREMBLE: ox += 1.8f * am * sinf(t * 53.f); oy += 1.3f * am * sinf(t * 47.f); break;
        case A_FLOAT: oy += 6.f * am * sinf(t * 1.25f); break;
        case A_WOBBLE: rotd += 7.f * am * sinf(t * 3.f); break;
        case A_LEAN: sc *= 1.f + 0.03f * am; break;
    }
    if (!reduced_) oy += 2.2f * sinf(t * 6.2831853f / 4.2f);   // breathing
    oy -= 4.f * talkS_;                          // talking: the head lifts a little on each syllable
    rotd += 1.6f * talkS_ * sinf(t * 9.f);
    if (gest_ && !reduced_) {
        float k = gestT_ / gestDur_, env = sinf(3.14159f * k);
        switch (gest_) {
            case G_NOD: oy += 13.f * fabsf(sinf(k * 6.2831853f)) * (1 - k * 0.4f); break;
            case G_SHAKE: ox += 16.f * sinf(k * 6.2831853f * 2.f) * (1 - k); break;
            case G_JUMP: oy -= 34.f * env; sc *= 1.f + 0.03f * env; break;
            case G_POP: sc *= 1.f + 0.09f * env; break;
            case G_TILT_L: rotd -= 11.f * env; break;
            case G_TILT_R: rotd += 11.f * env; break;
            case G_WIGGLE: rotd += 8.f * sinf(k * 6.2831853f * 2.f) * (1 - k); break;
        }
    }
    if(dizzy && !reduced_){rotd += 9.f*sinf(t*4.f);ox += 6.f*sinf(t*2.f);}
    ox += lookX_ * 7.f;
    oy += lookY_ * 5.f;
    Xf xf;
    xf.cx = cx + ox * pixelScale; xf.cy = cy + oy * pixelScale; xf.s = sc * pixelScale;
    xf.c = cosf(rotd * DEG); xf.sn = sinf(rotd * DEG);

    const char *motion=emotionName();
    if(custom_) {
        const auto &p=pixelPose_;
        if(p.armWave>.25f || p.rightArm>1.9f)motion="wave";
        else if(p.mouthPulse>.3f)motion="speaking";
        else if(fabsf(p.wink)>.4f)motion="wink";
        else if(p.brow>.5f && p.smile<0)motion="angry";
        else if(p.eyeOpen<.16f)motion="sleeping";
        else if(p.smile<-.45f)motion="sad";
        else if(p.eyeOpen>1.25f && p.mouthOpen>.4f)motion="surprised";
        else if(p.smile>.8f || (p.leftArm>1.7f && p.rightArm>1.7f))motion="happy";
        else if(p.leftArm>1.1f || fabsf(p.gazeX)>.4f)motion="thinking";
        else if(p.mouthOpen>.25f)motion="speaking";
        else if(p.eyeOpen>1.05f)motion="listening";
        else motion="idle";
    }
    if(custom_ && pixelPose_.motion[0]){for(const auto &m:PIXEL_MOTIONS)if(!strcmp(m.name,pixelPose_.motion)){motion=m.name;break;}}
    if(attention_)motion="listening";
    // Local shake speech must not replace the dizziness with a talking frame.
    if(talkS_>.04f && !dizzy)motion="speaking";
    const PixelMotion *sequence=&PIXEL_MOTIONS[0];
    for(const auto &m:PIXEL_MOTIONS)if(!strcmp(m.name,motion)){sequence=&m;break;}
    int duration=0;for(int i=0;i<sequence->count;i++)duration+=sequence->frames[i].ms;
    int clock=reduced_ ? 0:(int)(fmodf(t,duration/1000.f)*1000),frame=sequence->frames[0].pose;
    for(int i=0;i<sequence->count;i++){if(clock<sequence->frames[i].ms){frame=sequence->frames[i].pose;break;}clock-=sequence->frames[i].ms;}
    if(!custom_ && !attention_ && talkS_<.04f && blink_>.65f && !strcmp(motion,"idle"))frame=1;
    // Crisp nearest-neighbour sprites. No per-pixel SDFs, alpha blending, decoder
    // allocations or 3D lighting. The atlas resides in flash.
    float scale=2.95f*xf.s; // ~12% smaller, leaving breathing room around the halo
    const uint8_t *bounds=(pip_==PIXEL_RIG_COUNT && asset_) ? asset_->bounds[frame]:PIXEL_BOUNDS[pip_][frame];
    float left=cv.w,top=cv.h,right=0,bottom=0;
    for(int corner=0;corner<4;corner++){
        float bx=(bounds[corner&1 ? 2:0]-48)*scale,by=(bounds[corner&2 ? 3:1]-48)*scale;
        float x=xf.cx+bx*xf.c-by*xf.sn,y=xf.cy+bx*xf.sn+by*xf.c;
        left=fminf(left,x);right=fmaxf(right,x);top=fminf(top,y);bottom=fmaxf(bottom,y);
    }
    int x0=std::max(0,(int)left-1),x1=std::min(cv.w,(int)right+2);
    int y0=std::max(0,(int)top-1),y1=std::min(cv.h,(int)bottom+2);
    // Track a single union so the overlapping halo and sprite are erased once.
    addRect(std::min(x0,halo.x0),std::min(y0,halo.y0),std::max(x1,halo.x1),std::max(y1,halo.y1));
    const uint16_t *pixels=(pip_==PIXEL_RIG_COUNT && asset_) ? asset_->pixels+frame*96*96:PIXEL_PIPS[pip_][frame];
    // Recolour only when a sprite/skin changes, never for every enlarged pixel.
#if defined(ARDUINO_ARCH_ESP32)
    static uint16_t *tinted=(uint16_t*)heap_caps_malloc(96*96*2,MALLOC_CAP_SPIRAM|MALLOC_CAP_8BIT);
#else
    static uint16_t tintStorage[96*96];uint16_t *tinted=tintStorage;
#endif
    static int cachedRig=-1,cachedFrame=-1;static uint32_t cachedColor=0;
    if(color_ && tinted && pip_<PIXEL_RIG_COUNT) {
        if(cachedRig!=pip_ || cachedFrame!=frame || cachedColor!=color_) {
            float rr=((color_>>16)&255)/255.f,gg=((color_>>8)&255)/255.f,bb=(color_&255)/255.f;
            float hi=fmaxf(rr,fmaxf(gg,bb)),lo=fminf(rr,fminf(gg,bb)),delta=hi-lo,hue=0;
            if(delta>0){if(hi==rr)hue=fmodf((gg-bb)/delta,6);else if(hi==gg)hue=(bb-rr)/delta+2;else hue=(rr-gg)/delta+4;}
            float angle=(hue*60-PIXEL_RIG_HUES[pip_])*DEG,c=cosf(angle),q=sinf(angle);
            const float m[9]={.213f+.787f*c-.213f*q,.715f-.715f*c-.715f*q,.072f-.072f*c+.928f*q,
                .213f-.213f*c+.143f*q,.715f+.285f*c+.140f*q,.072f-.072f*c-.283f*q,
                .213f-.213f*c-.787f*q,.715f-.715f*c+.715f*q,.072f+.928f*c+.072f*q};
            for(int i=0;i<96*96;i++) {
                uint16_t pixel=pixels[i];if(!pixel){tinted[i]=0;continue;}
                float r=((pixel>>11)&31)*255.f/31,g=((pixel>>5)&63)*255.f/63,b=(pixel&31)*255.f/31;
                int nr=(int)clampf(m[0]*r+m[1]*g+m[2]*b,0,255),ng=(int)clampf(m[3]*r+m[4]*g+m[5]*b,0,255),nb=(int)clampf(m[6]*r+m[7]*g+m[8]*b,0,255);
                pixel=(nr>>3)<<11|(ng>>2)<<5|(nb>>3);tinted[i]=pixel?pixel:1;
            }
            cachedRig=pip_;cachedFrame=frame;cachedColor=color_;
        }
        pixels=tinted;
    }
    if(dizzy){
#if defined(ARDUINO_ARCH_ESP32)
        static uint16_t *spiralTexture=(uint16_t*)heap_caps_malloc(96*96*2,MALLOC_CAP_SPIRAM|MALLOC_CAP_8BIT);
#else
        static uint16_t spiralBuffer[96*96];uint16_t *spiralTexture=spiralBuffer;
#endif
        if(spiralTexture){
            DizzyEyes eyes{};
            if(pip_==PIXEL_RIG_COUNT && asset_)eyes=asset_->dizzyEyes;
            else for(int i=0;i<2;i++){const float *e=PIXEL_DIZZY_EYES[pip_][i];eyes.eye[i]={e[0],e[1],e[2],e[3]};}
            memcpy(spiralTexture,pixels,96*96*2);paintDizzyEyes(spiralTexture,eyes,t);pixels=spiralTexture;
        }
    }
    // Fixed point inverse transform: two integer adds per pixel. floorf/division
    // in this inner loop are prohibitively slow on the Xtensa at native resolution.
    const float inv=65536.f/scale;
    const int32_t ux=(int32_t)(xf.c*inv),vx=(int32_t)(-xf.sn*inv);
    const int32_t uy=(int32_t)(xf.sn*inv),vy=(int32_t)(xf.c*inv);
    int32_t rowU=(int32_t)(((x0+.5f-xf.cx)*xf.c+(y0+.5f-xf.cy)*xf.sn)*inv+48*65536.f);
    int32_t rowV=(int32_t)((-(x0+.5f-xf.cx)*xf.sn+(y0+.5f-xf.cy)*xf.c)*inv+48*65536.f);
    for(int y=y0;y<y1;y++,rowU+=uy,rowV+=vy){
        int32_t u=rowU,v=rowV;uint16_t *dst=cv.px+y*cv.w+x0;
        for(int x=x0;x<x1;x++,u+=ux,v+=vx,dst++) {
            const int sx=u>>16,sy=v>>16;
            if((unsigned)sx>=96 || (unsigned)sy>=96)continue;
            const uint16_t pixel=pixels[sy*96+sx];
            if(pixel)*dst=cv.swapped ? (uint16_t)((pixel>>8)|(pixel<<8)):pixel;
        }
    }

    if(dizzy){
        // Small orbiting pixel stars work with every silhouette, including new
        // custom packs. Static under Reduce Motion; no allocations or timers.
        static const uint8_t star[5]={4,31,14,10,17};
        const uint16_t gold=0xff20,white=0xfffa;
        for(int i=0;i<3;i++){
            float phase=t*3.4f+i*2.0943951f;
            float bx=((bounds[0]+bounds[2])*.5f-48+14*cosf(phase))*scale;
            float by=(bounds[1]-48-2+4*sinf(phase))*scale;
            int sx=(int)lroundf(xf.cx+bx*xf.c-by*xf.sn),sy=(int)lroundf(xf.cy+bx*xf.sn+by*xf.c);
            int step=std::max(1,(int)lroundf(scale*.65f)),radius=3*step;
            int l=std::max(0,sx-radius),r=std::min(cv.w,sx+radius+1);
            int top=std::max(0,sy-radius),bottom=std::min(cv.h,sy+radius+1);
            if(l>=r || top>=bottom)continue;
            addRect(l,top,r,bottom);
            for(int y=0;y<5;y++)for(int x=0;x<5;x++)if(star[y]&(1<<x)){
                uint16_t color=(x==2 && y==1)?white:gold;
                if(cv.swapped)color=(color>>8)|(color<<8);
                for(int yy=0;yy<step;yy++)for(int xx=0;xx<step;xx++){
                    int px=sx+(x-2)*step+xx,py=sy+(y-2)*step+yy;
                    if((unsigned)px<(unsigned)cv.w && (unsigned)py<(unsigned)cv.h)cv.px[py*cv.w+px]=color;
                }
            }
        }
    }

    // 3) remember what we drew; dirty = old ∪ new
    for (int i = 0; i < nCur_; i++) {
        Rect r = cur_rects_[i];
        if (r.x0 < dirty.x0) dirty.x0 = r.x0; if (r.y0 < dirty.y0) dirty.y0 = r.y0;
        if (r.x1 > dirty.x1) dirty.x1 = r.x1; if (r.y1 > dirty.y1) dirty.y1 = r.y1;
        prev_[i] = r;
    }
    nPrev_ = nCur_;
    g_track = nullptr;
    return dirty;
}

static void trackCb(Face *f, int x0, int y0, int x1, int y1) {
    if (g_track) g_track->addRect(x0, y0, x1, y1);
}
